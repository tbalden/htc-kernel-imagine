/* Copyright (c) 2017, The Linux Foundation. All rights reserved.
 *
 * This program is free software; you can redistribute it and/or modify
 * it under the terms of the GNU General Public License version 2 and
 * only version 2 as published by the Free Software Foundation.
 *
 * This program is distributed in the hope that it will be useful,
 * but WITHOUT ANY WARRANTY; without even the implied warranty of
 * MERCHANTABILITY or FITNESS FOR A PARTICULAR PURPOSE.  See the
 * GNU General Public License for more details.
 */

/dts-v1/;
/plugin/;

#include <dt-bindings/clock/qcom,gcc-sdm845.h>
#include <dt-bindings/clock/qcom,camcc-sdm845.h>
#include <dt-bindings/clock/qcom,dispcc-sdm845.h>
#include <dt-bindings/clock/qcom,rpmh.h>
#include <dt-bindings/interrupt-controller/arm-gic.h>

#include "../qcom/sdm845-sde-display.dtsi"
#include "../qcom/sdm845-mtp.dtsi"
#include "../qcom/sdm845-audio-overlay.dtsi"

#include "sdm845-htc_ime.dtsi"
#include "tca6418-ime.dtsi"
#include "sdm845-display-ime.dtsi"
#include "sdm845-htc_ime_sony.dtsi"
#include "sdm845-camera-sensor-jpn-xb.dtsi"
#include "sdm845-htc_sdm845-nc-pins_imeuhljpn-xc.dtsi"
#include "sdm845-htc_sdm845-batt-jpn.dtsi"

/ {
        model = "HTC Corporation. SDM845 v2.1 IME JAPAN XC";
        compatible = "qcom,sdm845-mtp", "qcom,sdm845", "qcom,mtp";
        qcom,msm-id = <472 0x20001>;
        qcom,board-id = <0x2 0x0>;
};

&soc{
	edge-sentons{
		FLAT_KEY_ID = [01];
		NEW_KEY_ENG_ID = [11];
		NEW_KEY_ID = [02];
	};
};
