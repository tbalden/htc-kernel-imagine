/* Copyright (c) 2017, The Linux Foundation. All rights reserved.
 *
 * This program is free software; you can redistribute it and/or modify
 * it under the terms of the GNU General Public License version 2 and
 * only version 2 as published by the Free Software Foundation.
 *
 * This program is distributed in the hope that it will be useful,
 * but WITHOUT ANY WARRANTY; without even the implied warranty of
 * MERCHANTABILITY or FITNESS FOR A PARTICULAR PURPOSE.  See the
 * GNU General Public License for more details.
 */

/dts-v1/;
/plugin/;

#include <dt-bindings/clock/qcom,gcc-sdm845.h>
#include <dt-bindings/clock/qcom,camcc-sdm845.h>
#include <dt-bindings/clock/qcom,dispcc-sdm845.h>
#include <dt-bindings/clock/qcom,rpmh.h>
#include <dt-bindings/interrupt-controller/arm-gic.h>

#include "../qcom/sdm845-sde-display.dtsi"
#include "../qcom/sdm845-mtp.dtsi"
#include "../qcom/sdm845-audio-overlay.dtsi"

#include "sdm845-htc_ime.dtsi"
#include "tca6418-ime.dtsi"
#include "sdm845-display-ime.dtsi"
#include "sdm845-htc_ime-nfc.dtsi"
#include "sdm845-htc_sdm845-nc-pins_ime-xa.dtsi"
#include "sdm845-camera-sensor-xa.dtsi"

/ {
        model = "HTC Corporation. SDM845 v1 IME XA";
        compatible = "qcom,sdm845-mtp", "qcom,sdm845", "qcom,mtp";
        qcom,msm-id = <468 0x10000>, <469 0x10000>, <470 0x10000>, <471 0x10000>;
        qcom,board-id = <0x0 0x0>;
};

&nanohub {
	/* A+G: uint8 bit 0_3 */
	/* MAG: uint8 bit 4_7 */
	sensorhub,motion-sensor-placement = /bits/ 8 <0x03>;
	sensorhub,mag-pdc-matrix-flag = /bits/ 8 <0x01>;
};

&soc{
	edge-sentons{
		CONVEX_KEY_FLAG;
	};
};
