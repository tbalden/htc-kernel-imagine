qcom,ime-id1-batterydata {
	qcom, = <24>;
	/* #3283570_HTC_IMEatl_3420mAh_averaged_MasterSlave_Jan8th2018*/
	qcom,max-voltage-uv = <4400000>;
	qcom,nom-batt-capacity-mah = <3420>;
	qcom,batt-id-kohm = <10>;
	qcom,battery-beta = <4360>;
	qcom,battery-type = "ime_id1";
	qcom,checksum = <0x9FA2>;
	qcom,gui-version = "PMI8998GUI - 2.0.0.58";

	qcom,fastchg-current-ma = <3400>;
	qcom,fg-cc-cv-threshold-mv = <4390>;
	qqcom,fcc-mah = <3420>;

	htc,batt_id = <1>;
	htc,id_raw_min = <0>;
	htc,id_raw_max = <22000>;

	qcom,fg-profile-data = [
		 E5 1E D5 FC
		 B4 03 F0 06
		 E0 1C EA 01
		 D2 0D 92 0A
		 92 17 A8 23
		 D8 44 BB 53
		 6F 00 00 00
		 12 00 00 00
		 00 00 0F C5
		 64 C4 A0 CA
		 1E 00 08 00
		 66 E2 E1 ED
		 2B F4 AB F2
		 27 07 83 12
		 C6 04 DB 32
		 1C 06 09 20
		 27 00 14 00
		 7A 1F E8 05
		 41 0A 82 06
		 BD 1C 23 03
		 CC 15 75 12
		 84 18 D1 23
		 EB 4D 28 5B
		 64 00 00 00
		 0E 00 00 00
		 00 00 19 CC
		 5F CA 85 AC
		 19 00 00 00
		 0D EB E1 ED
		 C7 F5 EE EA
		 63 ED 09 03
		 6C 00 5A 1A
		 AA 33 CC FF
		 07 10 00 00
		 9F 0D 66 46
		 19 00 40 00
		 A0 01 0A FA
		 FF 00 00 00
		 00 00 00 00
		 00 00 00 00
		 00 00 00 00
		 00 00 00 00
		 00 00 00 00
		 00 00 00 00
		 00 00 00 00
		 00 00 00 00
		 00 00 00 00
		 00 00 00 00
		 00 00 00 00
		 00 00 00 00
		 00 00 00 00
		 00 00 00 00
		 00 00 00 00
		 00 00 00 00
		 00 00 00 00
		 00 00 00 00
	];
};
