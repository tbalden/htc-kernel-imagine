## drivers/gpu/msm/Kconfig
```kconfig
config QCOM_KGSL
	tristate "Qualcomm Technologies, Inc. 3D Graphics driver"
	default n
	depends on ARCH_QCOM
	select GENERIC_ALLOCATOR
	select FW_LOADER
	select PM_DEVFREQ
	select DEVFREQ_GOV_SIMPLE_ONDEMAND
	select DEVFREQ_GOV_PERFORMANCE
	select DEVFREQ_GOV_QCOM_ADRENO_TZ
	select DEVFREQ_GOV_QCOM_GPUBW_MON
	---help---
	  3D graphics driver for the Adreno family of GPUs from QTI.
	  Required to use hardware accelerated OpenGL, compute and Vulkan
	  on QTI targets. This includes power management, memory management,
	  and scheduling for the Adreno GPUs.

config QCOM_ADRENO_DEFAULT_GOVERNOR
	string "devfreq governor for the adreno core"
	default "msm-adreno-tz" if DEVFREQ_GOV_QCOM_ADRENO_TZ
	default "simple_ondemand"
	depends on QCOM_KGSL

config QCOM_KGSL_IOMMU
	bool
	default y if QCOM_KGSL && (MSM_IOMMU || ARM_SMMU)

config MSM_KGSL_DEFAULT_GPU_HUNG_NO_PANIC
	int "Bypass HTC change for GPU hung, go QCT origin flow"
	default -1
	---help---
	positive number:
		allow gpu fault n times.
		If fault time over n, kgsl trigger panic.
	zero:
		trigger panic if gpu fault.
	negative number:
		always go to QCT recovery patch.
		we set -1 for CRC stage.
```

## drivers/htc_mnemosyne/Kconfig
```kconfig
config HTC_DEBUG_FOOTPRINT
    bool "HTC Debug footprint support"
    default n
    help
      Say yes to enable HTC debug footprint for CPU related function.
```

## drivers/input/misc/snt8100fsr/Kconfig
```kconfig
#
# Sentons Edgesensor driver
#

config EDGE_SENTONS
       default n
       tristate "Sentons Edgesensor support"
       depends on SPI_MASTER || I2C
       select HTC_FEATURE
       help
         Say Y here to enable Sentons snt8100fsr edge sensor driver.

config HTC_FEATURE
       default n
       tristate "Enable HTC features"
       depends on EDGE_SENTONS
       select NANOHUB_SILEGO
       help
         Say Y here to enable HTC features for snt8100fsr driver.

config NANOHUB_SILEGO
       default n
       tristate "Enable HTC features with nanohub and silego"
       depends on HTC_FEATURE
       help
         Say Y here to enable HTC features with nanohub and silego.
```

## drivers/misc/fpr_FingerprintCard/Kconfig
```kconfig
#
# FingerprintCard fingerprint driver
#
menu "FingerprintCard fingerprint driver"
config FPR_FPC
       tristate "FPC_BTP fingerprint sensor support"
       depends on SPI_MASTER
       default n

config FPC_HTC_DISABLE_CHARGING
       tristate "HTC FPC disable charging while capturing image during enroll/verify"
       depends on FPR_FPC
       default n

config FPC_HTC_ENABLE_DBG
       tristate "HTC FPC enable dbg log"
       depends on FPR_FPC
       default y

config FPC_HTC_ENABLE_POWER
       tristate "HTC FPC enable power for fp sensor"
       depends on FPR_FPC
       default y

config FPC_HTC_ENABLE_WAKE_LOCK
       tristate "HTC FPC enable wake lock for fp sensor"
       depends on FPR_FPC
       default n

endmenu
```

## drivers/misc/goodix_fp/Kconfig
```kconfig
#
# Fingerprint driver configuration 
#
menu "Goodix fingerprint SPI driver"
config GOODIX_FP
       default n
       tristate "Goodix BTP fingerprint sensor support"
       depends on SPI_MASTER

config HTC_DISABLE_CHARGING
       default n
       tristate "HTC FP disable charging while capturing image during enroll/verify"
       depends on GOODIX_FP

config HTC_PCN_HAL_FOOTPRINT_CMD
       default n
       tristate "HTC sync time at kernel from HAL layer!"
       depends on GOODIX_FP

config HTC_PCN_FP_ENABLE_3V3_POWER
       default n
       tristate "HTC enable 3v3 power!"
       depends on GOODIX_FP

config HTC_PCN_FP_ENABLE_HW_RESET_PINCTRL
       default n
       tristate "HTC enable HW Reset with pinctrl!"
       depends on GOODIX_FP

config HTC_PCN_FP_ENABLE_WAKE_LOCK
       default n
       tristate "HTC enable wake lock!"
       depends on GOODIX_FP

config HTC_PCN_IRQ_ENABLE_LOG
       default n
       tristate "HTC enable irq log"
       depends on GOODIX_FP

endmenu
```

## drivers/ti/Kconfig
```kconfig
#
# PINCTRL infrastructure and drivers
#

config PINCTRL_TCA6418
        bool "TCA6418 pinctrl driver"
        depends on OF
        select I2C
        select PINMUX
        select PINCONF
        select GPIOLIB
        help
          Say Y here to enable the TCA6418 pinctrl driver
endmenu
```

## drivers/usb/tusb544/Kconfig
```kconfig
#
# USB device configuration
#

config TUSB544
	bool "TUSB544 usb3 re-drive"
	default n
	help
	  Say Y here to enable the TUSB544 usb3.0 re-drive
```
